## Kconfig.projbuild
```kconfig
rsource "main/Kconfig.projbuild"
rsource "components/test_apps/Kconfig.projbuild"
```

## components/test_apps/Kconfig.projbuild
```kconfig
menu "Test Applications"

    choice TEST_APP_MODE
        prompt "Select Test Application Mode"
        default TEST_APP_MODE_NONE
        help
            Select which test application to run. When a test app is selected,
            it replaces the normal FloraLink application. The bootloader will
            still perform signature verification before jumping to the test app.

        config TEST_APP_MODE_NONE
            bool "Normal FloraLink Application"
            help
                Run the normal FloraLink application (default mode).

        config TEST_APP_MODE_SECBOOT
            bool "Secure Boot Test Application"
            help
                Run comprehensive secure boot tests. Tests FIFO initialization,
                persistence, push/pop operations, and overflow behavior.

        config TEST_APP_MODE_LED
            bool "LED Pattern Test Application"
            help
                Run LED pattern and button control test. Tests onboard LED
                breathing, flashing, heartbeat patterns, and GPIO interrupts.

    endchoice

endmenu
```

## main/Kconfig.projbuild
```kconfig
menu "WiFi Configuration"
    config WIFI_SSID
        string "WiFi SSID"
        default "YOUR_SSID"
        help
            Enter the SSID of the WiFi network to connect to.

    config WIFI_PASS
        string "WiFi Password"
        default "YOUR_PASSWORD"
        help
            Enter the password for the WiFi network.
endmenu

menu "Secure Boot Configuration"
    config SECURE_BOOT_SANCTION_ENABLED
        bool "Enable Secure Boot Sanctions (status tracking)"
        default y
        help
            Enable boot status tracking and sanction policies.
            Records boot success/failure history to secboot_status partition.

    config SECURE_BOOT_WARN_ON_UNSIGNED
        bool "Warn on unsigned firmware"
        depends on SECURE_BOOT_SANCTION_ENABLED
        default y
        help
            Log warning when unsigned firmware is detected but allow boot to continue.

    config SECURE_BOOT_BLOCK_ON_UNSIGNED
        bool "Block boot on unsigned firmware (enforce signed-only)"
        depends on SECURE_BOOT_SANCTION_ENABLED
        default n
        help
            Block (halt) boot if firmware is unsigned. Only signed images allowed.
            Requires secure boot to be enabled and private key configured.

    config SECURE_BOOT_RESET_ON_FAIL
        bool "Reset on signature verification failure"
        depends on SECURE_BOOT_SANCTION_ENABLED
        default n
        help
            Automatically reset and retry boot if signature verification fails.
            Otherwise, halt for manual intervention.

    config SECURE_BOOT_FIFO_SIZE
        int "Boot status history FIFO size"
        depends on SECURE_BOOT_SANCTION_ENABLED
        range 4 32
        default 10
        help
            Number of boot status entries to keep in ring buffer.
            Default 10 entries = 10 bytes of storage.

endmenu

menu "FloraLink Configuration"

    orsource "$IDF_PATH/examples/common_components/env_caps/$IDF_TARGET/Kconfig.env_caps"

    choice BLINK_LED
        prompt "Blink LED type"
        default BLINK_LED_GPIO
        help
            Select the LED type. A normal level controlled LED or an addressable LED strip.
            The default selection is based on the Espressif DevKit boards.
            You can change the default selection according to your board.

        config BLINK_LED_GPIO
            bool "GPIO"
        config BLINK_LED_STRIP
            bool "LED strip"
    endchoice

    choice BLINK_LED_STRIP_BACKEND
        depends on BLINK_LED_STRIP
        prompt "LED strip backend peripheral"
        default BLINK_LED_STRIP_BACKEND_RMT if SOC_RMT_SUPPORTED
        default BLINK_LED_STRIP_BACKEND_SPI
        help
            Select the backend peripheral to drive the LED strip.

        config BLINK_LED_STRIP_BACKEND_RMT
            depends on SOC_RMT_SUPPORTED
            bool "RMT"
        config BLINK_LED_STRIP_BACKEND_SPI
            bool "SPI"
    endchoice

    config BLINK_GPIO
        int "Blink GPIO number"
        range ENV_GPIO_RANGE_MIN ENV_GPIO_OUT_RANGE_MAX
        default 8
        help
            GPIO number (IOxx) to blink on and off the LED.
            Some GPIOs are used for other purposes (flash connections, etc.) and cannot be used to blink.

    config BLINK_PERIOD
        int "Blink period in ms"
        range 10 3600000
        default 1000
        help
            Define the blinking period in milliseconds.
    
# GPIO pin used to read HVx or LVx of the level shifter for testing
    config GPIO_MONITOR_INPUT_PIN
        int "GPIO test monitor input pin"
        range ENV_GPIO_RANGE_MIN ENV_GPIO_OUT_RANGE_MAX
        default 5
        help
            GPIO number (IOxx) used to monitor another GPIO pulse using RMT.

    config FLORALINK_DEBUG_LED_ANIMATIONS
        bool "Enable Debug LED animations"
        default n
        help
            Show a brief breathing LED animation when entering idle mode.
            This provides visual feedback but extends active power consumption by ~4.5 seconds.
            
            Enabled: 2-cycle breathing animation (~4.5s, 15% overhead per active->idle transition)
            Disabled: Immediate sleep entry (0% overhead, maximum power savings)
            
            Recommended: Enable for development/debugging, disable for production battery-powered deployments.

endmenu
```
